#include "LedControl.h"
#include <pgmspace.h> // For PROGMEM to store font in flash

// Define the ESP32-C3 pins connected to the MAX7219
// Note that the ones here are NOT recommended ones and are merely the ones used by the author
// const int DIN_PIN = 1;
// const int CLK_PIN = 3;
// const int CS_PIN  = 2;

const int NUM_DEVICES = 4;
LedControl lc = LedControl(DIN_PIN, CLK_PIN, CS_PIN, NUM_DEVICES);

// --- FONT DATA  ---
const byte FONT[][5] PROGMEM = { 
  {0x00, 0x00, 0x00, 0x00, 0x00}, // Space
  {0x00, 0x00, 0x5F, 0x00, 0x00}, // !
  {0x00, 0x07, 0x00, 0x07, 0x00}, // "
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  {0x61, 0x51, 0x49, 0x45, 0x43}  // Z
};

byte getCharColumn(char character, int col) {
  if (col < 0 || col > 4) return 0x00;
  int charIndex = character - 32;
  if (charIndex < 0 || charIndex >= (sizeof(FONT) / sizeof(FONT[0]))) {
    charIndex = 0; // Default to space
  }
  return pgm_read_byte(&(FONT[charIndex][col]));
}

String message = "HELLO WORLD!! ESP32-C3";
const int CHAR_WIDTH = 5;
const int CHAR_SPACING = 1;
const int TOTAL_CHAR_PIXEL_WIDTH = CHAR_WIDTH + CHAR_SPACING;

const int MAX_MESSAGE_LEN = 50;
byte messageBuffer[MAX_MESSAGE_LEN * TOTAL_CHAR_PIXEL_WIDTH];
int messageBufferLen = 0;

int scrollOffset; 
unsigned long lastScrollTime = 0;
int scrollDelay = 75; // Milliseconds (speed)

const int DISPLAY_WIDTH_COLUMNS = NUM_DEVICES * 8;

void setup() {
  for (int i = 0; i < NUM_DEVICES; i++) {
    lc.shutdown(i, false);
    lc.setIntensity(i, 5); // Brightness (0-15)
    lc.setScanLimit(i, 7); 
    lc.clearDisplay(i);
  }

  buildMessageBuffer();
  scrollOffset = -DISPLAY_WIDTH_COLUMNS; 
}

void buildMessageBuffer() {
  messageBufferLen = 0;
  for (int i = 0; i < message.length(); i++) {
    char c = toupper(message.charAt(i));
    for (int col = 0; col < CHAR_WIDTH; col++) {
      if (messageBufferLen < sizeof(messageBuffer)) {
        messageBuffer[messageBufferLen++] = getCharColumn(c, col);
      }
    }
    for (int s = 0; s < CHAR_SPACING; s++) {
      if (messageBufferLen < sizeof(messageBuffer)) {
        messageBuffer[messageBufferLen++] = 0x00; // Blank column
      }
    }
  }
}

void displayMarquee() {
  for (int screenCol = 0; screenCol < DISPLAY_WIDTH_COLUMNS; screenCol++) {
    int device = screenCol / 8;
    int deviceCol = screenCol % 8;

    int currentMessageCol = scrollOffset + screenCol;
    byte colData = 0x00;

    if (currentMessageCol >= 0 && currentMessageCol < messageBufferLen) {
      colData = messageBuffer[currentMessageCol];
    }
    
    lc.setColumn(device, 7 - deviceCol, colData); 
  }
}

void loop() {
  if (millis() - lastScrollTime > scrollDelay) {
    lastScrollTime = millis();

    displayMarquee();
    scrollOffset++; // Increment to scroll text from RIGHT to LEFT visually
    
    if (scrollOffset >= messageBufferLen) {
      scrollOffset = -DISPLAY_WIDTH_COLUMNS; // Reset to re-enter from the right
    }
  }
}
